## overlay/Config.in
```kconfig
source "$BR2_EXTERNAL_HJORTRON_PATH/package/hjortron/Config.in"
source "$BR2_EXTERNAL_HJORTRON_PATH/package/hjortron-frontend/Config.in"
source "$BR2_EXTERNAL_HJORTRON_PATH/package/retroarch/Config.in"
source "$BR2_EXTERNAL_HJORTRON_PATH/package/sdl2_hjortron/Config.in"
```

## overlay/package/hjortron-frontend/Config.in
```kconfig
config BR2_PACKAGE_HJORTRON_FRONTEND
	bool "Hjortron libretro frontend"
	select BR2_PACKAGE_SDL2_FBCON
	select BR2_PACKAGE_SDL2_TTF_FBCON
	select BR2_PACKAGE_JANSSON
	select BR2_PACKAGE_SQLITE
	select BR2_PACKAGE_ALSA_LIB

	# Cores
	select BR2_PACKAGE_LIBRETRO_2048
	select BR2_PACKAGE_LIBRETRO_PICODRIVE
	select BR2_PACKAGE_LIBRETRO_LUTRO
	select BR2_PACKAGE_LIBRETRO_SCUMMVM
	select BR2_PACKAGE_LIBRETRO_YABAUSE

	help
		Hjortron frontend for libretro
```

## overlay/package/hjortron/Config.in
```kconfig
config BR2_PACKAGE_HJORTRON
	bool "Hjortron system package"
	select BR2_PACKAGE_HJORTRON_FRONTEND
	help
		Hjortron system
```

## overlay/package/retroarch/Config.in
```kconfig
# RetroArch & libretro game cores
source "$BR2_EXTERNAL_HJORTRON_PATH/package/retroarch/retroarch/Config.in"

source "$BR2_EXTERNAL_HJORTRON_PATH/package/retroarch/cores/Config.in"
```

## overlay/package/retroarch/cores/Config.in
```kconfig
source "$BR2_EXTERNAL_HJORTRON_PATH/package/retroarch/cores/libretro-2048/Config.in"
source "$BR2_EXTERNAL_HJORTRON_PATH/package/retroarch/cores/libretro-picodrive/Config.in"
source "$BR2_EXTERNAL_HJORTRON_PATH/package/retroarch/cores/libretro-lutro/Config.in"
source "$BR2_EXTERNAL_HJORTRON_PATH/package/retroarch/cores/libretro-scummvm/Config.in"
source "$BR2_EXTERNAL_HJORTRON_PATH/package/retroarch/cores/libretro-yabause/Config.in"
```

## overlay/package/retroarch/cores/libretro-lutro/Config.in
```kconfig
config BR2_PACKAGE_LIBRETRO_LUTRO
	bool "Libretro Lutro"
	help
	  Experimental Lua game framework for libretro, following the LÖVE API.
```

## overlay/package/retroarch/cores/libretro-picodrive/Config.in
```kconfig
config BR2_PACKAGE_LIBRETRO_PICODRIVE
	bool "Libretro Picodrive"
	help
	  Sega Mega Drive, Mega-CD, 32X emulator
```

## overlay/package/retroarch/cores/libretro-scummvm/Config.in
```kconfig
config BR2_PACKAGE_LIBRETRO_SCUMMVM
	bool "Libretro ScummVM"
	help
	  ScummVM is a program which allows you to run certain classic
	  graphical point-and-click adventure games, provided you already have
	  their data files.
```

## overlay/package/retroarch/cores/libretro-yabause/Config.in
```kconfig
config BR2_PACKAGE_LIBRETRO_YABAUSE
	bool "Libretro Yabause"
	help
	  Sega Saturn emulator
```

## overlay/package/retroarch/retroarch/Config.in
```kconfig
config BR2_PACKAGE_RETROARCH
	bool "RetroArch"
	select BR2_PACKAGE_SDL
	select BR2_PACKAGE_SDL_GFX
	select BR2_PACKAGE_SDL_IMAGE
	select BR2_PACKAGE_SDL_NET
	select BR2_PACKAGE_SDL_TTF
	select BR2_PACKAGE_SDL_MIXER

	# Cores
	select BR2_PACKAGE_LIBRETRO_2048
	select BR2_PACKAGE_LIBRETRO_PICODRIVE
	select BR2_PACKAGE_LIBRETRO_LUTRO
	select BR2_PACKAGE_LIBRETRO_SCUMMVM
	select BR2_PACKAGE_LIBRETRO_YABAUSE

	help
		RetroArch is a frontend for emulators, game engines and media players.

		It enables you to run classic games on a wide range of
		computers and consoles through its slick graphical
		interface. Settings are also unified so configuration
		is done once and for all.

		RetroArch has advanced features like shaders, netplay,
		rewinding, next-frame response times, and more!


		http://www.retroarch.com/
```

## overlay/package/sdl2_hjortron/Config.in
```kconfig
# Minimalistic build of SDL2 with fbcon video driver for hjortron
source "$BR2_EXTERNAL_HJORTRON_PATH/package/sdl2_hjortron/sdl2_fbcon/Config.in"
source "$BR2_EXTERNAL_HJORTRON_PATH/package/sdl2_hjortron/sdl2_ttf_fbcon/Config.in"
```

## overlay/package/sdl2_hjortron/sdl2_fbcon/Config.in
```kconfig
config BR2_PACKAGE_SDL2_FBCON
	bool "sdl2_fbcon"
	depends on !BR2_STATIC_LIBS
	select BR2_PACKAGE_ALSA_LIB
	help
	  Simple DirectMedia Layer 2 - SDL2 is a library that allows
	  programs portable low level access to a video framebuffer,
	  audio output, mouse, and keyboard. It is not compatible with
	  SDL1.

	  http://www.libsdl.org/

comment "sdl2 needs a toolchain w/ dynamic library"
	depends on BR2_STATIC_LIBS
```

## overlay/package/sdl2_hjortron/sdl2_ttf_fbcon/Config.in
```kconfig
config BR2_PACKAGE_SDL2_TTF_FBCON
	bool "sdl2_ttf_fbcon"
	depends on BR2_PACKAGE_SDL2_FBCON
	select BR2_PACKAGE_FREETYPE
	help
	  SDL2_ttf is a sample TrueType font library. It allows you to
	  use TrueType fonts in your SDL2 applications.

	  http://www.libsdl.org/projects/SDL_ttf/
```

## src/hjortron_defconfig
```kconfig
BR2_HAVE_DOT_CONFIG=y
BR2_HOST_GCC_AT_LEAST_4_5=y
BR2_HOST_GCC_AT_LEAST_4_6=y
BR2_HOST_GCC_AT_LEAST_4_7=y
BR2_HOST_GCC_AT_LEAST_4_8=y
BR2_HOST_GCC_AT_LEAST_4_9=y
BR2_HOST_GCC_AT_LEAST_5=y
BR2_HOST_GCC_AT_LEAST_6=y
BR2_HOST_GCC_AT_LEAST_7=y
BR2_HOST_GCC_AT_LEAST_8=y

#
# Kernel
#
BR2_LINUX_KERNEL_CONFIG_FRAGMENT_FILES="$(BR2_EXTERNAL_HJORTRON_PATH)/hjortron_kernel_fragment"
BR2_LINUX_KERNEL_CUSTOM_LOGO_PATH=""

#
# Commands
#
BR2_WGET="wget --passive-ftp -nd -t 3"
BR2_SVN="svn --non-interactive"
BR2_BZR="bzr"
BR2_GIT="git"
BR2_CVS="cvs"
BR2_LOCALFILES="cp"
BR2_SCP="scp"
BR2_HG="hg"
BR2_ZCAT="gzip -d -c"
BR2_BZCAT="bzcat"
BR2_XZCAT="xzcat"
BR2_LZCAT="lzip -d -c"
BR2_TAR_OPTIONS=""
BR2_DEFCONFIG="$(CONFIG_DIR)/defconfig"
BR2_DL_DIR="$(TOPDIR)/dl"
BR2_HOST_DIR="$(BASE_DIR)/host"


#
# Mirrors and Download locations
#
BR2_PRIMARY_SITE=""
BR2_BACKUP_SITE="http://sources.buildroot.net"
BR2_KERNEL_MIRROR="https://cdn.kernel.org/pub"
BR2_GNU_MIRROR="http://ftpmirror.gnu.org"
BR2_LUAROCKS_MIRROR="http://rocks.moonscript.org"
BR2_CPAN_MIRROR="http://cpan.metacpan.org"
BR2_JLEVEL=0
BR2_STRIP_strip=y
BR2_STRIP_EXCLUDE_FILES=""
BR2_STRIP_EXCLUDE_DIRS=""
BR2_OPTIMIZE_S=y
BR2_SHARED_LIBS=y
BR2_PACKAGE_OVERRIDE_FILE="$(CONFIG_DIR)/local.mk"
BR2_GLOBAL_PATCH_DIR=""

#
# Advanced
#
BR2_COMPILER_PARANOID_UNSAFE_PATH=y

#
# Security Hardening Options
#
BR2_SSP_NONE=y
BR2_RELRO_NONE=y

#
# Toolchain
#
BR2_TOOLCHAIN=y
BR2_TOOLCHAIN_USES_MUSL=y
BR2_TOOLCHAIN_BUILDROOT=y

#
# Toolchain Buildroot Options
#
BR2_TOOLCHAIN_BUILDROOT_VENDOR="buildroot"
BR2_TOOLCHAIN_BUILDROOT_MUSL=y
BR2_TOOLCHAIN_BUILDROOT_LIBC="musl"

#
# Binutils Options
#
BR2_PACKAGE_HOST_BINUTILS_SUPPORTS_CFI=y
BR2_BINUTILS_VERSION_2_29_X=y
BR2_BINUTILS_VERSION="2.29.1"
BR2_BINUTILS_ENABLE_LTO=y
BR2_BINUTILS_EXTRA_CONFIG_OPTIONS=""

#
# GCC Options
#
BR2_GCC_VERSION_7_X=y
BR2_GCC_SUPPORTS_LIBCILKRTS=y
BR2_GCC_VERSION="7.4.0"
BR2_EXTRA_GCC_CONFIG_OPTIONS=""
BR2_TOOLCHAIN_BUILDROOT_CXX=y
BR2_GCC_ENABLE_LTO=y
BR2_GCC_ENABLE_OPENMP=y
BR2_PACKAGE_HOST_GDB_ARCH_SUPPORTS=y

#
# Host GDB Options
#
BR2_PACKAGE_GDB_NEEDS_CXX11=y

#
# Toolchain Generic Options
#
BR2_TOOLCHAIN_SUPPORTS_ALWAYS_LOCKFREE_ATOMIC_INTS=y
BR2_USE_WCHAR=y
BR2_ENABLE_LOCALE=y
BR2_INSTALL_LIBSTDCPP=y
BR2_TOOLCHAIN_HAS_THREADS=y
BR2_TOOLCHAIN_HAS_THREADS_DEBUG=y
BR2_TOOLCHAIN_HAS_THREADS_NPTL=y
BR2_TOOLCHAIN_HAS_SSP=y
BR2_TOOLCHAIN_SUPPORTS_PIE=y
BR2_USE_MMU=y
BR2_TARGET_OPTIMIZATION=""
BR2_TARGET_LDFLAGS=""
BR2_TOOLCHAIN_HEADERS_AT_LEAST_3_0=y
BR2_TOOLCHAIN_HEADERS_AT_LEAST_3_1=y
BR2_TOOLCHAIN_HEADERS_AT_LEAST_3_2=y
BR2_TOOLCHAIN_HEADERS_AT_LEAST_3_3=y
BR2_TOOLCHAIN_HEADERS_AT_LEAST_3_4=y
BR2_TOOLCHAIN_HEADERS_AT_LEAST_3_5=y
BR2_TOOLCHAIN_HEADERS_AT_LEAST_3_6=y
BR2_TOOLCHAIN_HEADERS_AT_LEAST_3_7=y
BR2_TOOLCHAIN_HEADERS_AT_LEAST_3_8=y
BR2_TOOLCHAIN_HEADERS_AT_LEAST_3_9=y
BR2_TOOLCHAIN_HEADERS_AT_LEAST_3_10=y
BR2_TOOLCHAIN_HEADERS_AT_LEAST_3_11=y
BR2_TOOLCHAIN_HEADERS_AT_LEAST_3_12=y
BR2_TOOLCHAIN_HEADERS_AT_LEAST_3_13=y
BR2_TOOLCHAIN_HEADERS_AT_LEAST_3_14=y
BR2_TOOLCHAIN_HEADERS_AT_LEAST_3_15=y
BR2_TOOLCHAIN_HEADERS_AT_LEAST_3_16=y
BR2_TOOLCHAIN_HEADERS_AT_LEAST_3_17=y
BR2_TOOLCHAIN_HEADERS_AT_LEAST_3_18=y
BR2_TOOLCHAIN_HEADERS_AT_LEAST_3_19=y
BR2_TOOLCHAIN_HEADERS_AT_LEAST_4_0=y
BR2_TOOLCHAIN_HEADERS_AT_LEAST_4_1=y
BR2_TOOLCHAIN_HEADERS_AT_LEAST_4_2=y
BR2_TOOLCHAIN_HEADERS_AT_LEAST_4_3=y
BR2_TOOLCHAIN_HEADERS_AT_LEAST_4_4=y
BR2_TOOLCHAIN_HEADERS_AT_LEAST_4_5=y
BR2_TOOLCHAIN_HEADERS_AT_LEAST_4_6=y
BR2_TOOLCHAIN_HEADERS_AT_LEAST_4_7=y
BR2_TOOLCHAIN_HEADERS_AT_LEAST_4_8=y
BR2_TOOLCHAIN_HEADERS_AT_LEAST_4_9=y
BR2_TOOLCHAIN_HEADERS_AT_LEAST_4_10=y
BR2_TOOLCHAIN_HEADERS_AT_LEAST_4_11=y
BR2_TOOLCHAIN_HEADERS_AT_LEAST_4_12=y
BR2_TOOLCHAIN_HEADERS_AT_LEAST_4_13=y
BR2_TOOLCHAIN_HEADERS_AT_LEAST_4_14=y
BR2_TOOLCHAIN_HEADERS_AT_LEAST_4_15=y
BR2_TOOLCHAIN_HEADERS_AT_LEAST_4_16=y
BR2_TOOLCHAIN_HEADERS_AT_LEAST_4_17=y
BR2_TOOLCHAIN_HEADERS_AT_LEAST_4_18=y
BR2_TOOLCHAIN_HEADERS_AT_LEAST_4_19=y
BR2_TOOLCHAIN_HEADERS_AT_LEAST="4.19"
BR2_TOOLCHAIN_GCC_AT_LEAST_4_3=y
BR2_TOOLCHAIN_GCC_AT_LEAST_4_4=y
BR2_TOOLCHAIN_GCC_AT_LEAST_4_5=y
BR2_TOOLCHAIN_GCC_AT_LEAST_4_6=y
BR2_TOOLCHAIN_GCC_AT_LEAST_4_7=y
BR2_TOOLCHAIN_GCC_AT_LEAST_4_8=y
BR2_TOOLCHAIN_GCC_AT_LEAST_4_9=y
BR2_TOOLCHAIN_GCC_AT_LEAST_5=y
BR2_TOOLCHAIN_GCC_AT_LEAST_6=y
BR2_TOOLCHAIN_GCC_AT_LEAST_7=y
BR2_TOOLCHAIN_GCC_AT_LEAST="7"
BR2_TOOLCHAIN_HAS_MNAN_OPTION=y
BR2_TOOLCHAIN_HAS_SYNC_1=y
BR2_TOOLCHAIN_HAS_SYNC_2=y
BR2_TOOLCHAIN_HAS_SYNC_4=y
BR2_TOOLCHAIN_HAS_SYNC_8=y
BR2_TOOLCHAIN_HAS_LIBATOMIC=y
BR2_TOOLCHAIN_HAS_ATOMIC=y
BR2_TOOLCHAIN_HAS_LIBQUADMATH=y

#
# System configuration
#
BR2_ROOTFS_SKELETON_DEFAULT=y
BR2_ROOTFS_MERGED_USR=y
BR2_TARGET_GENERIC_HOSTNAME="hjortron"
BR2_TARGET_GENERIC_ISSUE="Welcome to hjortron"
BR2_TARGET_GENERIC_PASSWD_SHA256=y
BR2_TARGET_GENERIC_PASSWD_METHOD="sha-256"
BR2_INIT_BUSYBOX=y

#
# systemd needs a glibc toolchain w/ SSP, headers >= 3.10
#
BR2_ROOTFS_DEVICE_CREATION_DYNAMIC_EUDEV=y
BR2_ROOTFS_DEVICE_TABLE="system/device_table.txt"
BR2_TARGET_ENABLE_ROOT_LOGIN=y
BR2_TARGET_GENERIC_ROOT_PASSWD="hjortron"
BR2_SYSTEM_BIN_SH_BUSYBOX=y

#
# bash, dash, mksh, zsh need BR2_PACKAGE_BUSYBOX_SHOW_OTHERS
#
BR2_TARGET_GENERIC_GETTY=y
BR2_TARGET_GENERIC_GETTY_PORT="console"
BR2_TARGET_GENERIC_GETTY_BAUDRATE_KEEP=y
BR2_TARGET_GENERIC_GETTY_BAUDRATE="0"
BR2_TARGET_GENERIC_GETTY_TERM="vt100"
BR2_TARGET_GENERIC_GETTY_OPTIONS=""
BR2_TARGET_GENERIC_REMOUNT_ROOTFS_RW=y
BR2_SYSTEM_DHCP=""
BR2_ENABLE_LOCALE_PURGE=y
BR2_ENABLE_LOCALE_WHITELIST="C en_US"
BR2_SYSTEM_ENABLE_NLS=y
BR2_TARGET_TZ_INFO=y
BR2_TARGET_TZ_ZONELIST="default"
BR2_TARGET_LOCALTIME="Etc/UTC"
BR2_ROOTFS_USERS_TABLES=""
BR2_ROOTFS_OVERLAY=""
BR2_ROOTFS_POST_BUILD_SCRIPT=""
BR2_ROOTFS_POST_FAKEROOT_SCRIPT=""
BR2_ROOTFS_POST_IMAGE_SCRIPT=""


#
# Filesystem images
#
BR2_TARGET_ROOTFS_EXT2=y
BR2_TARGET_ROOTFS_EXT2_2=y
BR2_TARGET_ROOTFS_EXT2_2r1=y
BR2_TARGET_ROOTFS_EXT2_GEN=2
BR2_TARGET_ROOTFS_EXT2_REV=1
BR2_TARGET_ROOTFS_EXT2_LABEL=""
BR2_TARGET_ROOTFS_EXT2_SIZE="80M"
BR2_TARGET_ROOTFS_EXT2_INODES=0
BR2_TARGET_ROOTFS_EXT2_RESBLKS=5
BR2_TARGET_ROOTFS_EXT2_MKFS_OPTIONS="-O ^64bit"
BR2_TARGET_ROOTFS_EXT2_NONE=y

#
# Host utilities
#
BR2_PACKAGE_HOST_E2FSPROGS=y


#
# Target packages
#
BR2_PACKAGE_BUSYBOX=y
BR2_PACKAGE_BUSYBOX_CONFIG="package/busybox/busybox.config"
BR2_PACKAGE_BUSYBOX_CONFIG_FRAGMENT_FILES=""
BR2_PACKAGE_SKELETON=y
BR2_PACKAGE_HAS_SKELETON=y
BR2_PACKAGE_PROVIDES_SKELETON="skeleton-init-sysv"
BR2_PACKAGE_SKELETON_INIT_COMMON=y
BR2_PACKAGE_SKELETON_INIT_SYSV=y

# BR2_PACKAGE_XORG7=y
# BR2_PACKAGE_XSERVER_XORG_SERVER=y
# BR2_PACKAGE_XAPP_XINIT=y
# BR2_PACKAGE_XAPP_XRANDR=y
# BR2_PACKAGE_XAPP_XEV=y
# BR2_PACKAGE_XDRIVER_XF86_INPUT_EVDEV=y
# BR2_PACKAGE_XDRIVER_XF86_INPUT_KEYBOARD=y
# BR2_PACKAGE_XDRIVER_XF86_INPUT_MOUSE=y
# BR2_PACKAGE_XDRIVER_XF86_VIDEO_FBDEV=y
#

# BR2_PACKAGE_SDL2=y
# BR2_PACKAGE_SDL2_X11=y
# BR2_PACKAGE_ALSA_LIB=y

# BR2_PACKAGE_SDL2_GFX=y
# BR2_PACKAGE_SDL2_IMAGE=y
# BR2_PACKAGE_SDL2_MIXER=y
# BR2_PACKAGE_SDL2_NET=y
# BR2_PACKAGE_SDL2_TTF=y

BR2_PACKAGE_SDL_FBCON=y
BR2_PACKAGE_SDL_IMAGE_BMP=y
BR2_PACKAGE_SDL_IMAGE_GIF=y
BR2_PACKAGE_SDL_IMAGE_JPEG=y
BR2_PACKAGE_SDL_IMAGE_LBM=y
BR2_PACKAGE_SDL_IMAGE_PCX=y
BR2_PACKAGE_SDL_IMAGE_PNG=y
BR2_PACKAGE_SDL_IMAGE_PNM=y
BR2_PACKAGE_SDL_IMAGE_TARGA=y
BR2_PACKAGE_SDL_IMAGE_TIFF=y
BR2_PACKAGE_SDL_IMAGE_WEBP=y
BR2_PACKAGE_SDL_IMAGE_XCF=y
BR2_PACKAGE_SDL_IMAGE_XPM=y
BR2_PACKAGE_SDL_IMAGE_XV=y

BR2_PACKAGE_OPENAL=y
BR2_PACKAGE_LIBVORBIS=y

BR2_PACKAGE_LIBARCHIVE=y

# BR2_PACKAGE_MESA3D=y
# BR2_PACKAGE_MESA3D_LLVM=y
# BR2_PACKAGE_MESA3D_OPENGL_EGL=y
# BR2_PACKAGE_MESA3D_OPENGL_ES=y
# BR2_PACKAGE_MESA3D_GALLIUM_DRIVER_SVGA=y
# BR2_PACKAGE_MESA3D_GALLIUM_DRIVER_SWRAST=y
# BR2_PACKAGE_MESA3D_DRI_DRIVER_SWRAST=y

BR2_PACKAGE_HJORTRON=y
```

## src/targets/qemu_x86/defconfig
```kconfig
#
# Target options
#
BR2_ARCH_IS_64=y
BR2_ARCH_HAS_MMU_MANDATORY=y
BR2_x86_64=y
BR2_ARCH_HAS_TOOLCHAIN_BUILDROOT=y
BR2_ARCH="x86_64"
BR2_ENDIAN="LITTLE"
BR2_GCC_TARGET_ARCH="nocona"
BR2_BINFMT_SUPPORTS_SHARED=y
BR2_READELF_ARCH_NAME="Advanced Micro Devices X86-64"
BR2_BINFMT_ELF=y
BR2_X86_CPU_HAS_MMX=y
BR2_X86_CPU_HAS_SSE=y
BR2_X86_CPU_HAS_SSE2=y
BR2_X86_CPU_HAS_SSE3=y

#
# Kernel Header Options
#
BR2_KERNEL_HEADERS_AS_KERNEL=y
BR2_PACKAGE_HOST_LINUX_HEADERS_CUSTOM_4_19=y
BR2_PACKAGE_LINUX_HEADERS=y

#
# Kernel
#
BR2_LINUX_KERNEL=y
BR2_LINUX_KERNEL_LATEST_VERSION=y
BR2_LINUX_KERNEL_VERSION="4.19.7"
BR2_LINUX_KERNEL_PATCH=""
BR2_LINUX_KERNEL_USE_DEFCONFIG=y
BR2_LINUX_KERNEL_DEFCONFIG="x86_64"
BR2_LINUX_KERNEL_BZIMAGE=y
BR2_LINUX_KERNEL_GZIP=y
```

## src/targets/rs97/defconfig
```kconfig
#
# Target options
#
BR2_ARCH_HAS_MMU_MANDATORY=y
BR2_mipsel=y
BR2_ARCH_HAS_TOOLCHAIN_BUILDROOT=y
BR2_ARCH="mipsel"
BR2_ENDIAN="LITTLE"
BR2_GCC_TARGET_ARCH="mips32"
BR2_GCC_TARGET_ABI="32"
BR2_GCC_TARGET_NAN="legacy"
BR2_GCC_TARGET_FP32_MODE="32"
BR2_BINFMT_SUPPORTS_SHARED=y
BR2_READELF_ARCH_NAME="MIPS R3000"
BR2_BINFMT_ELF=y
BR2_MIPS_CPU_MIPS32=y
BR2_mips_32=y
BR2_MIPS_FP32_MODE_32=y
BR2_MIPS_FP32_MODE_XX is not set
BR2_MIPS_NAN_LEGACY=y
BR2_MIPS_OABI32=y
```
